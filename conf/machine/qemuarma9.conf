## conf/machine/qemuarma9.conf
```bitbake
#@TYPE: Machine
#@NAME: qemuarma9
#@DESCRIPTION: a9 vexpress

require qemuarma9.inc
require conf/machine/include/qemu.inc
DEFAULTTUNE ?= "armv7at"
require conf/machine/include/tune-cortexa9.inc

KERNEL_IMAGETYPE = "zImage"

SERIAL_CONSOLES ?= "115200;ttyAMA0 115200;ttyAMA1"

#Wic configuration
IMAGE_FSTYPES += "wic"
WKS_FILE ?= "qemuarma9-yocto.wks"

# Files that will be included in boot partition
IMAGE_BOOT_FILES ?= "zImage;kernel_a zImage;kernel_b vexpress-v2p-ca9.dtb;dtb_a vexpress-v2p-ca9.dtb;dtb_b uboot.env boot.scr"

CRIU_BUILD_ARCH = "armv7"

#Include u-boot
EXTRA_IMAGEDEPENDS += "u-boot"
UBOOT_MACHINE = "vexpress_ca9x4_defconfig"
# Include u-boot elf file in the images folder
UBOOT_ELF = "u-boot"

# Include u-boot default environment file
UBOOT_INITIAL_ENV = "uboot-init.env"
UBOOT_ENV_SIZE = "0x40000"

# Install uboot environment tools
IMAGE_INSTALL_append = " u-boot-fw-utils"

# Install ota-update app with its dependencies
IMAGE_INSTALL_append = " ota-update sd-img"

# For runqemu
QB_SYSTEM_NAME = "qemu-system-arm"
QB_MACHINE = "-machine vexpress-a9"
QB_DEFAULT_KERNEL = "u-boot.elf"
QB_MEM = "-m 256"
QB_SERIAL_OPT = "-serial stdio"
# QB_KERNEL_CMDLINE_APPEND = "console=ttyAMA0,115200 console=tty"
# vexpress does not have any PCI bus to support virtio-rng-pci,
# We define specific virtio block device for it.
QB_ROOTFS_OPT = "-sd ${DEPLOY_DIR}/images/${MACHINE}/sd.img"
QB_TAP_OPT = "-netdev tap,id=net0,ifname=@TAP@,script=no,downscript=no"
# QB_SLIRP_OPT = "-netdev user,id=net0"
QB_OPT_APPEND = "-nographic"
# QB_DTB = "zImage-vexpress-v2p-ca9.dtb"
# Overwrite virtio-net-pci defined in oe-core/meta/classes/qemuboot.bbclass,
# since vexpress does not support it.
QB_NETWORK_DEVICE = "-device virtio-net-device,netdev=net0,mac=@MAC@"
```

## wic/qemuarma9-yocto.wks
```
# short-description: Create SD card image for vexpress-a9
# long-description: Creates a partitioned SD card image for vexpress-a9.

part /boot --source bootimg-partition --ondisk mmcblk0 --fstype=ext4 --label boot --align 2 --use-uuid
part / --source rootfs --ondisk mmcblk0 --fstype=ext4 --label root --align 2 --use-uuid
```
